## mesh-stack/flrc-bench-espidf/main/Kconfig.projbuild
```kconfig
choice BENCH_MODE
    prompt "Benchmark mode"
    default BENCH_MODE_INTERACTIVE

config BENCH_MODE_INTERACTIVE
    bool "Interactive (serial commands)"
config BENCH_MODE_AUTONOMOUS_TX
    bool "Autonomous TX (auto-start, no PC)"
config BENCH_MODE_AUTONOMOUS_RX
    bool "Autonomous RX (auto-start, NVS storage)"
config BENCH_MODE_RANGE_TX
    bool "Range test TX (infinite loop, all modes)"
config BENCH_MODE_RANGE_RX
    bool "Range test RX (scan + GPS + CSV output)"
config BENCH_MODE_DUMP
    bool "NVS dump (read and print stored results)"
config BENCH_MODE_SPI_LOOPBACK
    bool "SPI loopback test (verify SPI wiring, no radio needed)"
config BENCH_MODE_CONTINUITY
    bool "Continuity test (detect solder shorts after soldering radio)"
endchoice

config RANGE_TEST_GPS
    bool "Enable GPS on range test RX board"
    default y
    depends on BENCH_MODE_RANGE_RX
    help
        Enable u-blox MAX-M10S GPS via UART1 GPIO1.
        If GPS not physically wired, reads return fix=0.

config RANGE_TEST_GPS_UART_RX_PIN
    int "GPS UART RX pin"
    default 1
    depends on RANGE_TEST_GPS

config RANGE_TEST_GPS_UART_TX_PIN
    int "GPS UART TX pin (-1 to disable)"
    default -1
    depends on RANGE_TEST_GPS

config RANGE_TEST_GPS_UART_BAUD
    int "GPS UART baud rate"
    default 9600
    depends on RANGE_TEST_GPS
```

## tracker/firmware/main/Kconfig.projbuild
```kconfig
config ENABLE_BMP280
    bool "Enable BMP280 pressure/temperature sensor"
    default y
    help
        Enable BMP280 sensor for pressure, temperature, and altitude readings.
        Disable for Minimal variant to save weight and power.

config ENABLE_GPS
    bool "Enable GPS module (u-blox MAX-M10S or compatible)"
    default n
    help
        Enable GPS via UART1. Uses GPIO1 (RX) and optionally GPIO0 (TX).
        GPS provides latitude, longitude, altitude, and satellite count.
        Must configure GPS to Airborne <1G mode for high-altitude operation.

config GPS_UART_RX_PIN
    int "GPS UART RX pin (receives NMEA from GPS module)"
    default 1
    depends on ENABLE_GPS

config GPS_UART_TX_PIN
    int "GPS UART TX pin (sends config to GPS module, -1 to disable)"
    default -1
    depends on ENABLE_GPS

config GPS_UART_BAUD
    int "GPS UART baud rate"
    default 9600
    depends on ENABLE_GPS

config ENABLE_FEM
    bool "Enable SKY66112 FEM (Power Amplifier + LNA)"
    default n
    help
        Enable SKY66112-11 front-end module for +24 dBm TX and LNA RX.
        Not needed for Minimal variant with wire dipole.

config FEM_TX_PIN
    int "FEM TX_EN GPIO pin"
    default 1
    depends on ENABLE_FEM

config FEM_RX_PIN
    int "FEM RX_EN GPIO pin"
    default 0
    depends on ENABLE_FEM

config ENABLE_ANTENNA_SWITCH
    bool "Enable SP4T antenna switch"
    default n
    help
        Enable SP4T switch for 4-antenna selection (Komfort variant).
        Not needed for Minimal variant with single wire dipole.

config ANTENNA_SWITCH_CTRL1_PIN
    int "SP4T CTRL_1 GPIO pin"
    default 21
    depends on ENABLE_ANTENNA_SWITCH

config ANTENNA_SWITCH_CTRL2_PIN
    int "SP4T CTRL_2 GPIO pin"
    default 20
    depends on ENABLE_ANTENNA_SWITCH

config TX_INTERVAL_SEC
    int "TX interval in seconds"
    default 60
    help
        Seconds between telemetry transmissions. Longer interval = longer flight.

config LOW_VOLTAGE_MV
    int "Low voltage threshold in millivolts"
    default 3300
    help
        Skip TX and enter deep sleep immediately if supercap voltage is below
        this threshold. Prevents brownout during low-power conditions.

config RADIO_FREQ_MHZ_X10
    int "Radio frequency in MHz * 10 (e.g. 8680 = 868.0 MHz)"
    default 8680
    help
        LoRa frequency * 10. 8680 for EU ISM (868.0 MHz), 4330 for Sub-GHz (433.0 MHz).

config RADIO_SF
    int "LoRa spreading factor"
    default 9
    help
        SF7 = fast/short range, SF12 = slow/long range. SF9 is a good balance.

config RADIO_TX_POWER_DBM
    int "TX power in dBm"
    default 22
    help
        LR2021 maximum is +22 dBm. With SKY66112 FEM: +24 dBm.
```

## tracker/firmware/sdkconfig.defaults
```kconfig
CONFIG_IDF_TARGET="esp32c3"

CONFIG_ESP_SYSTEM_DEFAULT_CPU_FREQ_80=y
CONFIG_ESP_SYSTEM_DEFAULT_CPU_FREQ=80

CONFIG_ESP_WIFI_ENABLED=n
CONFIG_ESP_BT_ENABLED=n

CONFIG_FREERTOS_HZ=1000

CONFIG_PM_ENABLE=y
CONFIG_PM_DFS_INIT_AUTO=y

CONFIG_SPI_MASTER_ISR_IN_IRAM=y

CONFIG_LOG_DEFAULT_LEVEL_INFO=y
CONFIG_LOG_DEFAULT_LEVEL=3

CONFIG_COMPILER_OPTIMIZATION_SIZE=y

CONFIG_ESP_SYSTEM_PANIC_PRINT_REBOOT=y

CONFIG_BOOTLOADER_LOG_LEVEL_WARN=y

CONFIG_ESP_SYSTEM_DEEP_SLEEP_WAKEUP_DELAY=1000

CONFIG_ESPTOOLPY_FLASHSIZE_4MB=y
CONFIG_ESPTOOLPY_FLASHSIZE="4MB"
```

## tracker/ground-station/receiver/main/Kconfig.projbuild
```kconfig
menu "Ground Station WiFi Uplink"

    config GS_WIFI_SSID
        string "WiFi SSID"
        default "YOUR_SSID"
        help
            WiFi network name for ground station uplink.

    config GS_WIFI_PASS
        string "WiFi Password"
        default "YOUR_PASSWORD"
        help
            WiFi network password for ground station uplink.

    config GS_UPLINK_URL
        string "Telemetry Uplink URL"
        default "http://localhost:8080/api/telemetry"
        help
            HTTP endpoint to POST telemetry JSON.
            Examples:
            - http://your-server:8080/api/telemetry
            - https://robot.cloud/api/v1/data

endmenu

menu "Ground Station Mesh Mode"

    config GS_ENABLE_MESH
        bool "Enable mesh packet reception (FIPS + pipeline)"
        default n
        help
            Enable reception of mesh-encrypted, fragmented packets.
            When disabled, only raw 28-byte telemetry is accepted.

    config GS_ENABLE_FIPS
        bool "Enable FIPS Noise IK encryption"
        default n
        depends on GS_ENABLE_MESH
        help
            Enable FIPS encryption layer on top of mesh pipeline.
            Requires pre-shared keys configured at build time.

    config GS_FIPS_LOCAL_KEY
        hex "FIPS local private key (64 hex chars = 32 bytes)"
        default 0x0000000000000000000000000000000000000000000000000000000000000000
        depends on GS_ENABLE_FIPS
        help
            Ground station's FIPS private key (secp256k1, 32 bytes).

    config GS_FIPS_REMOTE_KEY
        hex "FIPS balloon remote public key (66 hex chars = 33 bytes compressed)"
        default 0x000000000000000000000000000000000000000000000000000000000000000000
        depends on GS_ENABLE_FIPS
        help
            Balloon tracker's FIPS public key (compressed secp256k1, 33 bytes).

endmenu
```

## tracker/ground-station/receiver/sdkconfig.defaults
```kconfig
CONFIG_IDF_TARGET="esp32c3"

CONFIG_ESP_SYSTEM_DEFAULT_CPU_FREQ_80=y
CONFIG_ESP_SYSTEM_DEFAULT_CPU_FREQ=80

CONFIG_FREERTOS_HZ=1000

CONFIG_SPI_MASTER_ISR_IN_IRAM=y

CONFIG_LOG_DEFAULT_LEVEL_INFO=y
CONFIG_LOG_DEFAULT_LEVEL=3

CONFIG_COMPILER_OPTIMIZATION_SIZE=y

CONFIG_ESP_SYSTEM_PANIC_PRINT_REBOOT=y

CONFIG_BOOTLOADER_LOG_LEVEL_WARN=y

# WiFi disabled for bench test (re-enable for field deployment)
# CONFIG_ESP_WIFI_ENABLED is not set
# CONFIG_ESP_NETIF_TCPIP_LWIP is not set

CONFIG_ESP_CONSOLE_USB_SERIAL_JTAG=y

CONFIG_GS_WIFI_SSID="STUDIO"
CONFIG_GS_WIFI_PASS="statek2017"
CONFIG_GS_UPLINK_URL="http://localhost:8080/api/telemetry"
# CONFIG_GS_ENABLE_MESH is not set
```
