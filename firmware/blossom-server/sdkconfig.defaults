## firmware/esp32-c3-flrc/main/Kconfig.projbuild
```kconfig
menu "FLRC Continuous TX"

    config FLRC_CONT_TX
        bool "Use continuous TX firmware (main_cont_tx.cpp)"
        default n
        help
            Enable to compile main_cont_tx.cpp instead of main.cpp.
            This firmware sends packets back-to-back in a continuous loop
            for throughput benchmarking.

            Disable for the standard TX+RX combined firmware (main.cpp).

choice FLRC_CONT_TX_PAYLOAD
    prompt "Continuous TX payload size (bytes)"
    default FLRC_CONT_TX_PAYLOAD_255
    depends on FLRC_CONT_TX
    help
        Select the packet payload size for continuous TX mode.
        Must match the RX board's expected packet size.

config FLRC_CONT_TX_PAYLOAD_32
    bool "32 bytes"
config FLRC_CONT_TX_PAYLOAD_64
    bool "64 bytes"
config FLRC_CONT_TX_PAYLOAD_128
    bool "128 bytes"
config FLRC_CONT_TX_PAYLOAD_255
    bool "255 bytes (max FLRC payload)"
endchoice

endmenu
```

## mesh-stack/flrc-bench-espidf/sdkconfig.defaults
```kconfig
CONFIG_IDF_TARGET="esp32c3"
# CONFIG_ESP_DEFAULT_CPU_FREQ_MHZ_80 is not set
CONFIG_ESP_DEFAULT_CPU_FREQ_MHZ_160=y
CONFIG_ESP_DEFAULT_CPU_FREQ_MHZ=160
# CONFIG_LOG_DEFAULT_LEVEL_NONE is not set
CONFIG_LOG_DEFAULT_LEVEL=3
CONFIG_ESP_CONSOLE_USB_SERIAL_JTAG=y
# CONFIG_ESP_SYSTEM_PANIC_SILENT_REBOOT is not set
CONFIG_ESPTOOLPY_FLASHMODE_DIO=y
CONFIG_ESPTOOLPY_FLASHMODE="dio"
CONFIG_ESPTOOLPY_FLASHSIZE_4MB=y
CONFIG_ESPTOOLPY_FLASHSIZE="4MB"
# CONFIG_ESP_TASK_WDT is not set
# CONFIG_BENCH_MODE_FIFO_TX is not set
# CONFIG_BENCH_MODE_FAST_RX is not set
# CONFIG_BENCH_MODE_RAW_TX is not set
CONFIG_BENCH_MODE_RAW_RX=y
# CONFIG_BENCH_MODE_INTERACTIVE is not set
# CONFIG_BENCH_MODE_AUTONOMOUS_TX is not set
# CONFIG_BENCH_MODE_AUTONOMOUS_RX is not set
# CONFIG_BENCH_MODE_RANGE_TX is not set
# CONFIG_BENCH_MODE_RANGE_RX is not set
# CONFIG_BENCH_MODE_DUMP is not set
# CONFIG_BENCH_MODE_SPI_LOOPBACK is not set
# CONFIG_BENCH_MODE_CONTINUITY is not set
# CONFIG_BENCH_MODE_FIFO_TEST is not set
# CONFIG_BENCH_MODE_PROFILE is not set
# CONFIG_BENCH_MODE_FIPS_BRIDGE is not set
# CONFIG_BENCH_MODE_BOOTSEL_CTRL is not set
```

## tools/balloon_pressure_test/Kconfig.projbuild
```kconfig
# Kconfig for the balloon pressure test rig

config MEASUREMENT_INTERVAL
    int "Measurement interval in seconds"
    default 30
    range 5 3600
    help
        How often to read pressure and temperature from the sensor.
        Default: 30 seconds (short test).
        For long-term tests: 300 seconds (5 minutes).

menu "Over-pressure interlock"

config BALLOON_IL_DP_CUTOFF_MBAR
    int "Differential-pressure cut-off (mbar, P_internal - P_ambient)"
    default 5
    range 1 200
    help
        PLACEHOLDER — NOT a validated ceiling.  Hard ceiling on the differential
        pressure across the envelope wall.  When exceeded, the interlock closes
        the (normally-closed) fill valve and raises the alarm.

        The envelope is NOT a pressure vessel and is NOT rated to a burst
        pressure: the protocol's control variable is CIRCUMFERENCE, not
        pressure.  This cut-off is a GROSS over-inflation detector, not a
        working setpoint.  Its number must be derived from a bench
        characterisation of differential pressure vs circumference
        (docs/PRESTRETCH-OVERPRESSURE-INTERLOCK.md, bench session B1) before
        anyone treats it as real.

config BALLOON_IL_DP_RESET_MBAR
    int "Differential pressure required before a reset is allowed (mbar)"
    default 2
    range 0 200
    help
        A latched trip may only be cleared once the differential has fallen
        back below this value AND the sensor is healthy.  Must be <= the
        cut-off above.

config BALLOON_IL_MAX_FILL_S
    int "Hard fill-time ceiling (seconds)"
    default 10800
    range 60 86400
    help
        Redundant backstop against a stuck-open fill valve: the fill is closed
        after this many seconds regardless of pressure.  10800 s = 3 h.

endmenu
```

## tracker/firmware/bench_test/sdkconfig.defaults
```kconfig
CONFIG_IDF_TARGET="esp32c3"
CONFIG_ESP_SYSTEM_DEFAULT_CPU_FREQ_80=y
CONFIG_ESP_SYSTEM_DEFAULT_CPU_FREQ=80
CONFIG_ESP_WIFI_ENABLED=n
CONFIG_ESP_BT_ENABLED=n
CONFIG_FREERTOS_HZ=1000
CONFIG_SPI_MASTER_ISR_IN_IRAM=y
CONFIG_LOG_DEFAULT_LEVEL_INFO=y
CONFIG_LOG_DEFAULT_LEVEL=3
CONFIG_ESP_CONSOLE_USB_SERIAL_JTAG=y
CONFIG_COMPILER_OPTIMIZATION_SIZE=y
CONFIG_ESPTOOLPY_FLASHSIZE_4MB=y
CONFIG_ESPTOOLPY_FLASHSIZE="4MB"
CONFIG_ESP_TASK_WDT=n
CONFIG_ESP_INT_WDT=n
```
